// index.html.inc Inlog page in raw data format
//
const char index_html[] = 
"<!doctype html>"
"<html>"
" <head>"
"  <meta charset='utf-8'>"
"  <meta http-equiv='X-UA-Compatible' content='IE=edge,chrome=1'>"
"  <meta name='viewport' content='width=device-width, initial-scale=1'>"
"  <title>APCswitch log-in</title>"
"  <link rel='stylesheet' type='text/css' href='style.css'>"
" </head>"
" <body onload='firstfill()'>"
"  <ul>"
"   <li><a class='pull-left' href='#'>APCswitch</a></li>"
"   <li><a class='pull-left active' href='/index.html'>Home</a></li>"
"   <li><a class='pull-left' href='/outlets.html'>Outlets</a></li>"
"   <li><a class='pull-left' href='/config.html'>Config</a></li>"
"   <li><a class='pull-left' href='/network.html'>Network</a></li>"
"   <li><a class='pull-left' href='/about.html'>About</a></li>"
"  </ul>\r\n"
"  <br><br><br>"
"  <center>"
"   <h1>APCSwitch log-in</h1>"
"   <table>"
"    <tr><td>User:</td><td><input type='text' id='user' name='user' required></td></tr>"
"    <tr><td>Password:</td><td><input type='password' id='password' name='password' required></td></tr>"
"   </table>"
"   <br><br><button class='button' onclick='httplogin()'>Log in</button>"
"   <br><input type='text' size='60' id='resultstr' placeholder=''>"
"  </center>"
"  <br><br>"
" </body>"
"</html>\r\n"
"<script>"
" function httplogin()"
" {"
"  var us = document.getElementById('user').value.trim();"
"  var pw = document.getElementById('password').value.trim();"
"  var xhr = new XMLHttpRequest();"
"  var theUrl = 'login?user=' + us + '?password=' + pw;"
"  resultstr.value = 'Log-in requested';"
"  xhr.onreadystatechange = function() {"
"   if ( xhr.readyState == XMLHttpRequest.DONE )"
"   {"
"    resultstr.value = xhr.responseText.trim();"
 "  }"
"  };"
"  xhr.open ( 'GET', theUrl );"
"  xhr.send();"
" }"
"\r\n"
" function firstfill()"
" {"
"  user.value = '';"
"  password.value = '';"
"  resultstr.value = '';"
" }"
"</script>"
"<noscript>"
" Sorry, APCswitch web-interface does not work without JavaScript!"
"</noscript>\r\n";
