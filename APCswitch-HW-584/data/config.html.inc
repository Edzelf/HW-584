const char config_html[] = "<!doctype html>"
"<html>"
" <head>"
"  <meta charset='utf-8'>"
"  <meta http-equiv='X-UA-Compatible' content='IE=edge,chrome=1'>"
"  <meta name='viewport' content='width=device-width, initial-scale=1'>"
"  <title>APCswitch configuration</title>"
"  <link rel='stylesheet' type='text/css' href='style.css'>"
" </head>"
" <body onload='firstfill()'>"
"  <ul>"
"   <li><a class='pull-left' href='#'>APCswitch</a></li>"
"   <li><a class='pull-left' href='/index.html'>Home</a></li>"
"   <li><a class='pull-left' href='/outlets.html'>Outlets</a></li>"
"   <li><a class='pull-left active' href='/config.html'>Config</a></li>"
"   <li><a class='pull-left' href='/network.html'>Network</a></li>"
"   <li><a class='pull-left' href='/about.html'>About</a></li>"
"  </ul>"
"  <br><br><br>"
"  <center>"
"   <h1>APCSwitch User- and Server configuration</h1>"
"   <table id='tab1_u' style='display: inline-block;'>"
"    <tbody id='tbody_u'>"
"    <tr><th>ID</th><th>Username</th><th>Password</th><th>Outlets</th></tr>"
"    <tr><td>1</td><td>none</td><td>none</td><td>none</td></tr>"
"    <tr><td>2</td><td>none</td><td>none</td><td>none</td></tr>"
"    <tr><td>3</td><td>none</td><td>none</td><td>none</td></tr>"
"    <tr><td>4</td><td>none</td><td>none</td><td>none</td></tr>"
"    <tr><td>5</td><td>none</td><td>none</td><td>none</td></tr>"
"    <tr><td>6</td><td>none</td><td>none</td><td>none</td></tr>"
"    <tr><td>7</td><td>none</td><td>none</td><td>none</td></tr>"
"    <tr><td>8</td><td>none</td><td>none</td><td>none</td></tr>"
"    </tbody>"
"   </table>"
"   &nbsp;&nbsp;&nbsp;"
"   <table id='tab1_o' style='display: inline-block;'>"
"    <tbody id='tbody_o'>"
"    <tr><th>Outlet</th><th>ServerID</th></tr>"
"    <tr><td>1</td><td>none</td></tr>"
"    <tr><td>2</td><td>none</td></tr>"
"    <tr><td>3</td><td>none</td></tr>"
"    <tr><td>4</td><td>none</td></tr>"
"    <tr><td>5</td><td>none</td></tr>"
"    <tr><td>6</td><td>none</td></tr>"
"    <tr><td>7</td><td>none</td></tr>"
"    <tr><td>8</td><td>none</td></tr>"
"    </tbody>"
"   </table>"
"   <br><br><button class='button' onclick='saveconf()'>Save</button>"
"   <br><br><br><input type='text' size='60' id='resultstr' placeholder=''>"
"  </center>"
"  <br><br>"
" </body>"
"</html>\r\n"
"<script>"
"\r\n"
// Firstfill will read binary data from the host.  The contents is the apcdata struct.
// 00..07   Name of user 0
// 08..15   Password of user 0
// 16..23   Mask of outlets for user 0
// 24..31   Name of user 1
// 32..39   Password of user 1
// 40..47   Mask of outlets for user 1
// ..
// 192..199 Server ID on outlet 1
// 200..207 Server ID on outlet 2
// ..
// 248..255 Server ID on outlet 8
//
" function firstfill()"
" {"
"  var xhr = new XMLHttpRequest() ;"
""
"  var theUrl = 'get_config' ;"
"  resultstr.value = 'Reading config info' ;"
"  xhr.onreadystatechange = function()"
"  {"
"   var rw2, n, u, id, un, up, um, sn, c ;"
"   var table = document.getElementById('tab1_u') ;"
""
"   if ( xhr.readyState == XMLHttpRequest.DONE )"
"   {"
"    rw2 = xhr.responseText ;"
"    resultstr.value = '' ;"
"    for ( u = 0 ; u < 8 ; u++ )"
"    {"
"     un = rw2.substring(24*u,24*u+8);"
"     up = rw2.substring(24*u+8,24*u+16);"
"     um = rw2.substring(24*u+16,24*u+24);"
"     id = 'UN_' + u;"
"     s = '<input size=\"10\" id=\"' + id + '\">';"
"     table.rows[u+1].cells[1].innerHTML = s;"
"     document.getElementById(id).value = un.trim();"
"     id = 'UP_' + u;"
"     s = '<input type=\"password\" size=\"10\" id=\"' + id + '\">';"
"     table.rows[u+1].cells[2].innerHTML = s;"
"     document.getElementById(id).value = up.trim();"
"     id = 'UM_' + u;"
"     s = '<input size=\"9\" id=\"' + id + '\">';"\
"     table.rows[u+1].cells[3].innerHTML = s;"
"     document.getElementById(id).value = um.trim();"
"    }"
"    table = document.getElementById('tab1_o');"
"    for ( n = 0 ; n < 8 ; n++ )"
"    {"
"     sn = rw2.substring(192+n*8,192+n*8+8);"
"     id = 'O_' + n;"
"     s = '<input size=\"9\" id=\"' + id + '\">';" 
"     table.rows[n+1].cells[1].innerHTML=s;"
"     document.getElementById(id).value = sn.trim();"
"    }"
"    resultstr.value = '';"
"   }"
"  };"
"  xhr.open ( 'GET', theUrl ) ;"
"  xhr.send() ;"
" }"
"\r\n"
" function saveconf()"
" {"
"  var n, m, i = 0, id, us, up, um, sn;"
"  var xhr = new XMLHttpRequest() ;"
"  var theUrl = 'put_config' ;"
"  var apcdata = new ArrayBuffer(256);"
"  var int8View = new Uint8Array(apcdata);"
""
"  resultstr.value = 'Save config requested' ;\r\n"
"  for ( n = 0 ; n < 8 ; n++ )"
"  {"
"   id = 'UN_' + n ;"
"   un = document.getElementById(id).value.padEnd(8) ;"
"   id = 'UP_' + n ;"
"   up = document.getElementById(id).value.padEnd(8) ;"
"   id = 'UM_' + n ;"
"   um = document.getElementById(id).value.padEnd(8) ;\r\n"
"   for ( m = 0 ; m < 8 ; m++ )"
"   {"
"    int8View[n*24+m] = un.charCodeAt(m) ;"
"    int8View[n*24+8+m] = up.charCodeAt(m);"
"    int8View[n*24+16+m] = um.charCodeAt(m);"
"   }"
"  }\r\n"
"  for ( n = 0 ; n < 8 ; n++ )"
"  {"
"   id = 'O_' + n ;"
"   sn = document.getElementById(id).value.padEnd(8) ;"
"   for ( m = 0 ; m < 8 ; m++ )"
"   {"
"    int8View[192+n*8+m] = sn.charCodeAt(m);"
"   }"
"  }"
"  xhr.onreadystatechange = function() {\r\n"
"   if ( xhr.readyState == XMLHttpRequest.DONE )"
"    {"
"     resultstr.value = xhr.responseText.trim() ;"
"    }"
"   };"
"   xhr.open ( 'POST', theUrl, false ) ;"
"   xhr.send(apcdata) ;\r\n"
" }"
"\r\n"
"</script>"
"<noscript>"
"  Sorry, APCswitch web-interface does not work without JavaScript!"
"</noscript>\r\n" ;
