// about.html.inc About page in raw data format
//
const char about_html[] = 
"<!doctype html>"
"<html>"
" <head>"
"  <meta charset='utf-8'>"
"  <meta http-equiv='X-UA-Compatible' content='IE=edge,chrome=1'>"
"  <meta name='viewport' content='width=device-width, initial-scale=1'>"
"  <title>About APCswitch</title>"
"  <link rel='stylesheet' type='text/css' href='style.css'>"
" </head>"
" <body onload='firstfill()'>"
"  <ul>"
"   <li><a class='pull-left' href='#'>APCswitch</a></li>"
"   <li><a class='pull-left active' href='/index.html'>Home</a></li>"
"   <li><a class='pull-left' href='/outlets.html'>Outlets</a></li>"
"   <li><a class='pull-left' href='/config.html'>Config</a></li>"
"   <li><a class='pull-left' href='/network.html'>Network</a></li>"
"   <li><a class='pull-left' href='/about.html'>About</a></li>"
"  </ul>\r\n"
"  <br><br><br>"
"  <center>"
"   <h1>About APCSwitch</h1>"
    "APCswitch can be used to powercycle remote servers<br>"
    "See documentation for details<br>"
    "Software by nielsonm236<br>"
    "Modified by Ed Smallenburg<br><br>"
    "<p><a href=\"https://github.com/nielsonm236/NetMod-ServerApp\">Visit nielsom236's github page</a></p>"
    "<p><a href=\"https://github.com/Edzelf\">Visit Ed's github page</a></p>"
"  </center>"
"  <br><br>"
" </body>"
"</html>\r\n" ;
