// network.html.inc Inlog page in raw data format
//
const char network_html[] =
"<!doctype html>"
"<html>"
" <head>"
"  <meta charset='utf-8'>"
"  <meta http-equiv='X-UA-Compatible' content='IE=edge,chrome=1'>"
"  <meta name='viewport' content='width=device-width, initial-scale=1'>"
"  <title>APCswitch network configuration</title>"
"  <link rel='stylesheet' type='text/css' href='style.css'>"
" </head>"
" <body onload='firstfill()'>"
"  <ul>"
"   <li><a class='pull-left' href='#'>APCswitch</a></li>"
"   <li><a class='pull-left' href='/index.html'>Home</a></li>"
"   <li><a class='pull-left' href='/outlets.html'>Outlets</a></li>"
"   <li><a class='pull-left' href='/config.html'>Config</a></li>"
"   <li><a class='pull-left active' href='/network.html'>Network</a></li>"
"   <li><a class='pull-left' href='/about.html'>About</a></li>"
"  </ul>"
"  <br><br><br>"
"  <center>"
"   <h1>APCSwitch network settings</h1>"
"   <table id='tabl_n' style='display: inline-block;'>"
"    <tr><th colspan='5'>Network</th></tr>"
"    <tr><td>IP</td><td>none</td><td>none</td><td>none</td><td>none</td></tr>"
"    <tr><td>MASK</td><td>none</td><td>none</td><td>none</td><td>none</td></tr>"
"    <tr><td>GATEWAY</td><td>none</td><td>none</td><td>none</td><td>none</td></tr>"
"   </table><br><br>"
"   <table id='tabl_f' style='display: inline-block;'>"
"    <tr><th colspan='5'>Whitelist (CIDR format)</th></tr>"
"    <tr><th colspan='4'>IP</th><th>/nn</th></tr>"
"    <tr><td>none</td><td>none</td><td>none</td><td>none</td><td>none</td></tr>"
"    <tr><td>none</td><td>none</td><td>none</td><td>none</td><td>none</td></tr>"
"    <tr><td>none</td><td>none</td><td>none</td><td>none</td><td>none</td></tr>"
"    <tr><td>none</td><td>none</td><td>none</td><td>none</td><td>none</td></tr>"
"    <tr><td>none</td><td>none</td><td>none</td><td>none</td><td>none</td></tr>"
"    <tr><td>none</td><td>none</td><td>none</td><td>none</td><td>none</td></tr>"
"    <tr><td>none</td><td>none</td><td>none</td><td>none</td><td>none</td></tr>"
"    <tr><td>none</td><td>none</td><td>none</td><td>none</td><td>none</td></tr>"
"   </table>"
"   &nbsp;&nbsp;&nbsp;\r\n"
"   <br><br><button class='button' onclick='saveconf()'>Save</button>"
"   <br><br><br><input type='text' size='60' id='resultstr' placeholder=''>"
"  </center>"
"  <br><br>"
" </body>"
"</html>\r\n"
"<script>\r\n"
" function firstfill()\r\n"
" {\r\n"
"  var xhr = new XMLHttpRequest() ;\r\n"
"\r\n"
"  var theUrl = 'get_network' ;\r\n"
"  resultstr.value = 'Reading network config' ;\r\n"
"  xhr.onload = function(oEvent)\r\n"
"  {\r\n"
"   var ab, row, col, cell, id, s ;\r\n"
"   var table = document.getElementById('tabl_n') ;\r\n"
"\r\n"
"   ab = xhr.response;\r\n"
"   if ( ab )\r\n"
"   {\r\n"
"    var rw2 = new Uint8Array(ab);\r\n"
"    for ( row = 0 ; row < 3 ; row++ )\r\n"
"    {\r\n"
"     for ( col = 0 ; col < 4 ; col++ )\r\n"
"     {\r\n"
"      id = 'N_' + row + col ;\r\n"
"      s = '<input size=\"4\" id=\"' + id + '\">' ;\r\n"
"      table.rows[row+1].cells[col+1].innerHTML=s;\r\n"
"      document.getElementById(id).value = rw2[row*4+col];\r\n"
"     }\r\n"
"    }\r\n"
"    table = document.getElementById('tabl_f') ;\r\n"
"    for ( row = 0 ; row < 8 ; row++ )\r\n"
"    {\r\n"
"     for ( col = 0 ; col < 5 ; col++ )\r\n"
"     {\r\n"
"      id = 'F_' + row + col ;\r\n"
"      s = '<input size=\"4\" id=\"' + id + '\">' ;\r\n"
"      table.rows[row+2].cells[col].innerHTML=s;\r\n"
"      document.getElementById(id).value = rw2[row*5+col+12];\r\n"
"     }\r\n"
"    }\r\n"
"    resultstr.value = 'Config read';\r\n"
"   }\r\n"
"  }\r\n"
"  xhr.open ( 'GET', theUrl, true ) ;\r\n"
"  xhr.responseType = 'arraybuffer';\r\n"
"  xhr.send() ;\r\n"
" }\r\n"
"\r\n"
" function saveconf()"
" {"
"  var id, row, col ;"
"  var xhr = new XMLHttpRequest() ;"
"  var theUrl = 'put_network' ;"
"  var netdata = new ArrayBuffer(52);"
"  var int8View = new Uint8Array(netdata);"
"\r\n"
"  resultstr.value = 'Save network config requested' ;\r\n"
"  for ( row = 0 ; row < 3 ; row++ )\r\n"
"  {\r\n"
"   for ( col = 0 ; col < 4 ; col++ )\r\n"
"   {\r\n"
"    id = 'N_' + row + col ;\r\n"
"    int8View[row*4+col] = document.getElementById(id).value;\r\n"
"   }\r\n"
"  }\r\n"
"  for ( row = 0 ; row < 8 ; row++ )\r\n"
"  {\r\n"
"   for ( col = 0 ; col < 5 ; col++ )\r\n"
"   {\r\n"
"    id = 'F_' + row + col ;\r\n"
"    int8View[row*5+col+12] = document.getElementById(id).value;\r\n"
"   }\r\n"
"  }\r\n"
"  xhr.onreadystatechange = function() {\r\n"
"   if ( xhr.readyState == XMLHttpRequest.DONE )\r\n"
"   {\r\n"
"    resultstr.value = xhr.responseText.trim() ;\r\n"
"   }\r\n"
"  }\r\n"
"  xhr.open ( 'POST', theUrl, false ) ;\r\n"
"  xhr.send(netdata) ;\r\n"
" }\r\n"
""
"</script>\r\n"
"<noscript>"
"  Sorry, APCswitch web-interface does not work without JavaScript!"
"</noscript>\r\n" ;
