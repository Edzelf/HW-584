// outlets_html.h Outlets page in raw data format
//
const char outlets_html[] =
"<!doctype html>"
"<html>"
" <head>"
"  <meta charset='utf-8'>"
"  <meta http-equiv='X-UA-Compatible' content='IE=edge,chrome=1'>"
"  <meta name='viewport' content='width=device-width, initial-scale=1'>"
"  <title>APCswitch outlets</title>"
"  <link rel='stylesheet' type='text/css' href='style.css'>"
" </head>\r\n"
" <body onload='firstfill()'>"
"  <ul>"
"   <li><a class='pull-left' href='#'>APCswitch</a></li>"
"   <li><a class='pull-left' href='/index.html'>Home</a></li>"
"   <li><a class='pull-left active' href='/outlets.html'>Outlets</a></li>"
"   <li><a class='pull-left' href='/config.html'>Config</a></li>"
"   <li><a class='pull-left' href='/network.html'>Network</a></li>"
"   <li><a class='pull-left' href='/about.html'>About</a></li>"
"  </ul>"
"  <br><br><br>"
"  <center>"
"   <h1>Switch Outlets</h1>"
"   <table id='tab1'>"
"   </table>"
"   <br><input type='text' size='60' id='resultstr' placeholder=''>"
"  </center>"
"  <br><br>"
" </body>"
"</html>\r\n"
"<script>\r\n"
" var svrid = [];\r\n"
"\r\n"
" function firstfill()\r\n"
" {\r\n"
"  fillserverids();"
"  filloutlets();"
" }\r\n"
""
" function filloutlets()\r\n"
" {\r\n"
"  var xhr = new XMLHttpRequest() ;\r\n"
"\r\n"
"  var theUrl = 'get_outlets' ;\r\n"
"  resultstr.value = 'Reading outlet info' ;\r\n"
"  xhr.onreadystatechange = function()\r\n"
"  {\r\n"
"   var outlets, n, row, cell, id, chn, rownr ;\r\n"
"   var table = document.getElementById('tab1') ;\r\n"
"\r\n"
"   if ( xhr.readyState == XMLHttpRequest.DONE )\r\n"
"   {\r\n"
"    outlets = xhr.responseText ;\r\n"
"    rownr = 0 ;"
"    for ( n = 0 ; n < 8 ; n++ )\r\n"
"    {\r\n"
"     id = outlets.charCodeAt(n);\r\n"
"     if ( id > 0x30 && id < 0x39 )\r\n"
"     {"
"      row = table.insertRow();\r\n"
"      cell = row.insertCell();\r\n"
"      cell.innerHTML = ' ' + String.fromCharCode(id) + ' ';\r\n"
"      chn = ( id - 1 ) & 7 ;\r\n"
"      cell = row.insertCell();\r\n"
"      cell.innerHTML = svrid[chn];\r\n"
"      cell = row.insertCell();\r\n"
"      var bb = \"<button class='button' onclick='oswitch(\" + rownr + \")'>Reset</button>\" ;\r\n"
"      cell.innerHTML = bb ;\r\n"
"      rownr++ ;"
"     }\r\n"
"    }\r\n"
"    resultstr.value = '' ;\r\n"
"   }\r\n"
"  }\r\n"
"  xhr.open ( 'GET', theUrl ) ;\r\n"
"  xhr.send() ;\r\n"
" }\r\n"
" function fillserverids()"
" {"
"  var xhr = new XMLHttpRequest() ;"
""
"  var theUrl = 'get_svrids' ;"
"  resultstr.value = 'Reading server info' ;"
"  xhr.onreadystatechange = function()"
"  {"
"   var rw2, n, sn ;"
""
"   if ( xhr.readyState == XMLHttpRequest.DONE )"
"   {"
"    rw2 = xhr.responseText ;"
"    svrid = [] ;"
"    for ( n = 0 ; n < 8 ; n++ )"
"    {"
"     sn = rw2.substring(n*8,n*8+8);"
"     svrid.push ( sn.trim() );"
"    }"
"   }"
"  };"
"  xhr.open ( 'GET', theUrl ) ;"
"  xhr.send() ;"
" }"
"\r\n"
""
" function oswitch(rownr)\r\n"
" {\r\n"
"  var xhr = new XMLHttpRequest();\r\n"
"  var table = document.getElementById('tab1');\r\n"
"  var svr_id = table.rows[rownr].cells[1].innerHTML;\r\n"
"  var chn = table.rows[rownr].cells[0].innerHTML;\r\n"
"  var theUrl = '/get_switch?nr=' + ( chn - 1 ) ;\r\n"
""
"  resultstr.value = 'Power cycle ' + svr_id;\r\n"
"  xhr.onreadystatechange = function(){\r\n"
"   if ( xhr.readyState == XMLHttpRequest.DONE )"
"   {"
"    resultstr.value = resultstr.value + '.  ' + xhr.responseText.trim();"
"   }"
"  }\r\n"
"  xhr.open ( 'GET', theUrl ) ;"
"  xhr.send() ;\r\n"
" }\r\n"
"</script>\r\n"
"<noscript>\r\n"
"  Sorry, APCswitch web-interface does not work without JavaScript!\r\n"
"</noscript>\r\n" ;
